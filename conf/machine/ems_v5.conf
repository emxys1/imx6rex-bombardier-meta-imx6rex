## conf/machine/ems_v5.conf
```bitbake
#@TYPE: Machine
#@NAME: Freescale i.MX6Q SABRE Smart Device
#@SOC: i.MX6Q
#@DESCRIPTION: Machine configuration for Freescale i.MX6Q TME V5 By Bombardier
#@MAINTAINER: Angel MC <ext.angel.munoz@es.transport.bombardier.com>

BBPATH .= ":${LAYERDIR}/../meta-fsl-arm"

require conf/machine/include/imx6sabresd-common.inc

SOC_FAMILY = "mx6:mx6q"

KERNEL_DEVICETREE = "imx6q-sabresd.dtb imx6q-sabresd-ldo.dtb imx6q-sabresd-hdcp.dtb \
                     imx6q-sabresd-enetirq.dtb imx6q-sabresd-uart.dtb"

UBOOT_CONFIG ??= "sd"
UBOOT_CONFIG[sd] = "mx6qsabresd_config,sdcard"
UBOOT_CONFIG[sata] = "mx6qsabresd_sata_config"
UBOOT_CONFIG[mfgtool] = "mx6qsabresd_config"

SERIAL_CONSOLE = "115200 ttymxc1"
MACHINE_FEATURES_remove = "pci bluetooth touchscreen"
```
